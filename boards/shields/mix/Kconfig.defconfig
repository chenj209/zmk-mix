## boards/shields/mix/Kconfig.defconfig
```kconfig
if SHIELD_MIX_LEFT

config ZMK_KEYBOARD_NAME
    default "mix"

config ZMK_SPLIT_ROLE_CENTRAL
    default y

config ZMK_SPLIT_BLE_CENTRAL_BATTERY_LEVEL_FETCHING
    default y

config ZMK_SPLIT_BLE_CENTRAL_BATTERY_LEVEL_PROXY
    default y


endif

if SHIELD_MIX_LEFT || SHIELD_MIX_RIGHT

config ZMK_POINTING
    default y

config SPI
    default y

config ZMK_SPLIT
    default y

endif
```

## config/west.yml
```yaml
manifest:
  remotes:
  - name: zmkfirmware
    url-base: https://github.com/zmkfirmware
  - name: mctechnology17
    url-base: https://github.com/mctechnology17
  - name: geeksville
    url-base: https://github.com/geeksville

    
  projects:
  - name: zmk
    remote: zmkfirmware
    revision: v0.3
    import: app/west.yml
  - name: cirque-input-module
    remote: geeksville
    revision: toucan
  - name: zmk-nice-oled
    remote: mctechnology17
    revision: main
  self:
    path: config
```
